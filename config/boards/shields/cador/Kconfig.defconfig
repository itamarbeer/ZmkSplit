## config/boards/shields/cador/Kconfig.defconfig
```kconfig
if SHIELD_CADOR_LEFT

config ZMK_KEYBOARD_NAME
    default "Cador"

config ZMK_SPLIT_ROLE_CENTRAL
    default y

endif

if SHIELD_CADOR_LEFT || SHIELD_CADOR_RIGHT

config ZMK_SPLIT
    default y

endif
```

## config/boards/shields/caldera/Kconfig.defconfig
```kconfig
if SHIELD_Cador_LEFT

config ZMK_KEYBOARD_NAME
    default "Cador"

config ZMK_SPLIT_ROLE_CENTRAL
    default y

endif

if SHIELD_Cador_LEFT || SHIELD_Cador_RIGHT

config ZMK_SPLIT
    default y

endif
```

## config/boards/shields/caldera/Kconfig.shield
```kconfig
config SHIELD_CADOR_LEFT
    def_bool $(shields_list_contains,cador_left)

config SHIELD_CADOR_RIGHT
    def_bool $(shields_list_contains,cador_right)
```
